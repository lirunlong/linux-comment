## kernel_driver/arm-drv-2.6.28/Kconfig
```kconfig
#
# Kconfig for shrek6410 board
#

menuconfig SHREK_DRV
	bool "Drivers for shrek6410 board"
	help
	  Specific drivers for shrek6410 board

if SHREK_DRV
config DRV01
	tristate "Char driver for single buffer"
	help
	  xxx

config DRV02
	tristate "Char driver for multi buffer"
	help
	  xxx

config LED01
	tristate "Char driver for LEDs"
	help
	  support 4 leds, use on|off control

config KEY01
	tristate "Test driver for keys"
	help
	  interrupt test

config TIMER01
	tristate "Test for software de-quiver"
	help
	  timer test

config ATOM01
	tristate "Test for atomic_t"
	help
	  xxx

config SPIN01
	tristate "Test for spinlock_t"
	help
	  xxx

source "drivers/arm-drv/01input/Kconfig"

endif #SHREK_DRV
```

## kernel_driver/arm-drv-3.4.4/01net/Kconfig
```kconfig
#
# Kconfig for shrek6410 board's specific drivers
# author: zht
# date: 2012-12-04
#

menuconfig SHREK_NET
	bool "Driver for network devices"

if SHREK_NET

config NET01
	tristate "Network driver for DM9000A"
	---help---
	  standard network driver for shrek6410 board's DM9000A ethernet chip

endif #SHREK_NET
```

## kernel_driver/arm-drv-3.4.4/02fb/Kconfig
```kconfig
#
# Kconfig for S3C6410 Display controller(FIMD)
# Author: zht
# Date: 2012-12-04
#

menuconfig SHREK_FB
	bool "Driver for S3C6410 FIMD"

if SHREK_FB

config FB01
	tristate "FB driver 1 for S3C6410 display controller (FIMD)"
	select FB_CFB_FILLRECT
	select FB_CFB_COPYAREA
	select FB_CFB_IMAGEBLIT
	---help---
	  standard frame buffer driver for S3C6410 display controller, support Win0 to Win4

choice
prompt "Select LCD Type"
default S3CFB_LCD43
config S3CFB_LCD43
	bool "4.3 inch LCD 480*272"
	---help---
	  TBA

config S3CFB_LCD5A
	bool "5.0 inch LCD 640*480"
	---help---
	  TBA

config S3CFB_LCD7A
	bool "7.0 inch LCD 800*480"
	---help---
	  TBA
endchoice


config S3CFB_OPTION
	tristate "Advanced options for S3C Framebuffer"
	default n
	---help---
	  TBA

choice
depends on S3CFB_OPTION
prompt "Select BPP(Bits Per Pixel)"
default S3CFB_BPP_16

config S3CFB_BPP_8
	bool "8 BPP"
	---help---
	  TBA

config S3CFB_BPP_16
	bool "16 BPP"
	---help---
	  TBA

config S3CFB_BPP_24
	bool "24 BPP(XRGB888)"
	---help---
	  TBA

config S3CFB_BPP_28
	bool "28 BPP(ARGB4888)"
	---help---
	  TBA
endchoice

config S3CFB_NUM
	int "Number of Windows"
	depends on S3CFB_OPTION
	default "1"
	---help---
	  TBA

config S3CFB_DOUBLE_BUFFER
	bool "Enable Double Buffering"
	depends on S3CFB_OPTION
	default n
	---help---
	  TBA

endif #SHREK_FB
```

## kernel_driver/arm_drv/Kconfig
```kconfig
#
# Kconfig for shrek6410 board
#

menuconfig SHREK_DRV
	bool "Drivers for shrek6410 board"
	help
	  Specific drivers from shrek6410 board


if SHREK_DRV


config DRV01
	tristate "Char driver for single buffer"
	help
	  xxx

config DRV02
	tristate "Char driver for multi buffer"
	help
	  xxx

config DRV03
	tristate "Char driver for multi buffer 2"
	help
	  xxx
config DRV_LED
	tristate "char driver for led"
	help
	  xxx
endif #SHREK_DRV
```

## kernel_driver/work/arm-drv/01input/Kconfig
```kconfig
#
# Kconfig for shrek6410 board's specific drivers
# author: zht
# date: 2012-12-04
#

menuconfig SHREK_INPUT
	bool "Driver for input devices"

if SHREK_INPUT

config PAD01
	tristate "Input driver for Keypad"
	---help---
	  standard input driver for shrek6410 board's keypad

config TS01
	tristate "Input driver for Touchscreen"
	---help---
	  standard input driver for shrek6410 board's Touchscreen

endif #SHREK_INPUT
```

## kernel_driver/work/tmp/arm-drv/drv2628/01input/Kconfig
```kconfig
#
# Kconfig for shrek6410 board's specific drivers
# author: zht
# date: 2012-12-04
#

menuconfig SHREK_INPUT
	bool "Driver for input devices"

if SHREK_INPUT

config KEYS01
	tristate "Input driver for Keys"
	---help---
	  standard input driver for shrek6410 board's keys

config TS01
	tristate "Input driver for Touchscreen"
	---help---
	  standard input driver for shrek6410 board's Touchscreen

endif #SHREK_INPUT
```

## kernel_driver/work/tmp/arm-drv/drv344/Kconfig
```kconfig
#
# Kconfig for shrek6410 board specific drivers
# author: zht
# date: 2012-12-04
#

menuconfig SHREK6410_DRV
	bool "Driver for shrek6410 board"
	help
	  Specific drivers for shrek6410 board

if SHREK6410_DRV

source "drivers/arm-drv/01net/Kconfig"
source "drivers/arm-drv/02fb/Kconfig"

endif # SHREK6410_DRV
```
